## arch/um/config.in
```kconfig
define_bool CONFIG_USERMODE y

mainmenu_name "Linux/Usermode Kernel Configuration"

define_bool CONFIG_ISA n
define_bool CONFIG_SBUS n
define_bool CONFIG_PCI n

define_bool CONFIG_UID16 y

define_bool CONFIG_RWSEM_XCHGADD_ALGORITHM y

mainmenu_option next_comment
comment 'Code maturity level options'
bool 'Prompt for development and/or incomplete code/drivers' CONFIG_EXPERIMENTAL
endmenu

mainmenu_option next_comment
comment 'General Setup'

bool 'Separate kernel address space support' CONFIG_MODE_SKAS

# This is to ensure that at least one of the modes is enabled.  When neither
# is present in defconfig, they default to N, which is bad.
if [ "$CONFIG_MODE_SKAS" != "y" ]; then
   define_bool CONFIG_MODE_TT y
fi

bool 'Tracing thread support' CONFIG_MODE_TT
if [ "$CONFIG_MODE_TT" != "y" ]; then
   bool 'Statically linked binary when CONFIG_MODE_TT is disabled' CONFIG_STATIC_LINK
fi
bool 'Networking support' CONFIG_NET
bool 'System V IPC' CONFIG_SYSVIPC
bool 'BSD Process Accounting' CONFIG_BSD_PROCESS_ACCT
bool 'Sysctl support' CONFIG_SYSCTL
tristate 'Kernel support for a.out binaries' CONFIG_BINFMT_AOUT
tristate 'Kernel support for ELF binaries' CONFIG_BINFMT_ELF
tristate 'Kernel support for MISC binaries' CONFIG_BINFMT_MISC

tristate 'Host filesystem' CONFIG_HOSTFS
tristate 'Usable host filesystem' CONFIG_HUMFS

if [ "$CONFIG_HOSTFS" = "y" -o "$CONFIG_HUMFS" = "y" ]; then
    define_tristate CONFIG_EXTERNFS y
fi

tristate 'Honeypot proc filesystem' CONFIG_HPPFS
bool 'Management console' CONFIG_MCONSOLE
dep_bool 'Magic SysRq key' CONFIG_MAGIC_SYSRQ $CONFIG_MCONSOLE
bool '2G/2G host address space split' CONFIG_HOST_2G_2G

bool 'Symmetric multi-processing support' CONFIG_UML_SMP
define_bool CONFIG_SMP $CONFIG_UML_SMP
if [ "$CONFIG_SMP" = "y" ]; then
    int  'Maximum number of CPUs (2-32)' CONFIG_NR_CPUS 32
fi

int 'Nesting level' CONFIG_NEST_LEVEL 0
int 'Kernel address space size (in .5G units)' CONFIG_KERNEL_HALF_GIGS 1
bool 'Highmem support' CONFIG_HIGHMEM
bool '/proc/mm' CONFIG_PROC_MM
int 'Kernel stack size order' CONFIG_KERNEL_STACK_ORDER 2
bool 'Real-time Clock' CONFIG_UML_REAL_TIME_CLOCK
endmenu

mainmenu_option next_comment
comment 'Loadable module support'
bool 'Enable loadable module support' CONFIG_MODULES
if [ "$CONFIG_MODULES" = "y" ]; then
# MODVERSIONS does not yet work in this architecture
#   bool '  Set version information on all module symbols' CONFIG_MODVERSIONS
    bool '  Kernel module loader' CONFIG_KMOD
fi
endmenu

source arch/um/config_char.in

source arch/um/config_block.in

define_bool CONFIG_NETDEVICES $CONFIG_NET

if [ "$CONFIG_NET" = "y" ]; then
   source arch/um/config_net.in
   source net/Config.in
fi

source fs/Config.in

mainmenu_option next_comment
comment 'SCSI support'

tristate 'SCSI support' CONFIG_SCSI

if [ "$CONFIG_SCSI" != "n" ]; then
   source arch/um/config_scsi.in
fi
endmenu

source drivers/md/Config.in

source drivers/mtd/Config.in

source lib/Config.in

mainmenu_option next_comment
comment 'Kernel hacking'
bool 'Debug memory allocations' CONFIG_DEBUG_SLAB
bool 'Enable kernel debugging symbols' CONFIG_DEBUGSYM
if [ "$CONFIG_XTERM_CHAN" = "y" ]; then
   dep_bool 'Enable ptrace proxy' CONFIG_PT_PROXY $CONFIG_DEBUGSYM
else 
   define_bool CONFIG_PT_PROXY n
fi

if [ "$CONFIG_MODE_TT" = "n" ]; then
   dep_bool 'Enable gprof support' CONFIG_GPROF $CONFIG_DEBUGSYM
fi

dep_bool 'Enable gcov support' CONFIG_GCOV $CONFIG_DEBUGSYM
endmenu
```
